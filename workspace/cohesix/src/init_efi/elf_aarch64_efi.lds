/* EFI linker script for aarch64 – autogenerated for Cohesix */
/* CLASSIFICATION: COMMUNITY */
/* Filename: elf_aarch64_efi.lds v0.6 */
/* Author: Lukas Bower */
/* Date Modified: 2026-09-13 */
/* SPDX-License-Identifier: MIT */

OUTPUT_FORMAT("elf64-littleaarch64")
ENTRY(_start)

PHDRS
{
    text PT_LOAD FLAGS(5);
    data PT_LOAD FLAGS(6);
}

SECTIONS
{
    .text ALIGN(0x1000) :
    {
        *(.text*)
        *(.rodata*)
    } :text

    .data ALIGN(0x1000) :
    {
        *(.data*)
    } :data

    .bss ALIGN(0x1000) (NOLOAD) :
    {
        *(COMMON)
        *(.bss*)
    } :data

    /DISCARD/ : { *(.note.GNU-stack) }
}
